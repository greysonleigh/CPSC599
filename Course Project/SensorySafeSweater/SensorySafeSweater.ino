/* Title: The Sensory Safe Sweater
 * Author: Greyson Mannella
 * 
 * This program uses the Grove ear-clip heart rate sensor and Grove speaker to create
 * a safe sensory environment. The electronic components attach to the inside of a 
 * sweater. Changes in the wearer's heart rate are detected by the sensor, and the
 * Arduino uses an interrupt to update this value in real time. Once the heart rate
 * is calculated, this prompts the speaker to play one of four short PCM audio clips,
 * varying depending on the speed of the wearer's heart rate.
 * 
 * This program includes functions from FrankieChu of Seeedstudio, and High-Low Tech
 * of MIT Media Lab where indicated. See course website for further details.
 */

#include <PCM.h>

unsigned char counter;   //initialize counter array index used for the interrupt
unsigned long readingArray[21];  //initialize array for interrupt
unsigned long inactivity;       //initialize variable for length of inactivity from sensor, in seconds
bool pulseDetected = true; //initialize boolean variable, indicating whether a heart rate is detected
unsigned int heartRate; //initialize variable for heart rate calculation
const int bpmMaxDelayTimer = 2000; //2 seconds - returns error if the duty overtrip 2 second.


//PCM audio of a Pokemon sound effect. Source: Pokemon Cries on YouTube. Edited by Greyson Mannella.
const unsigned char rowletCry[] PROGMEM = {
  126, 127, 127, 127, 128, 128, 128, 128, 128, 128, 128, 128,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 103, 
};


//PCM audio of a cat meow. Source: 16GPanskaZlochova_Eliska on Freesound. Edited by Greyson Mannella.
const unsigned char mrrp[] PROGMEM = {
  126, 126, 125, 125, 126, 126, 127, 127, 127, 127, 128, 128,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 130, 
};


//PCM audio of a guitar jingle. Source: DDmyzik on Freesound. Edited by Greyson Mannella.
const unsigned char guitarJingle[] PROGMEM = {
  126, 127, 127, 127, 127, 127, 127, 127, 127, 127, 127, 127,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 130,  
};


//PCM audio of an owl hoot. Source: Ivolipa on Freesound. Edited by Greyson Mannella.
const unsigned char owlHoot[] PROGMEM = {
  129, 129, 129, 129, 129, 128, 128, 128, 128, 128, 129, 129,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 145, 
};


void setup() {
  Serial.begin(9600);
  arrayInit();
  attachInterrupt(0, interrupt, RISING);//set interrupt 0, digital port 2
}


void loop() {
}


/*arrayInit(): initializes the array.
Modified from code by FrankieChu.*/
void arrayInit()
{
  for (unsigned char i = 0; i < 20; i ++)
  {
    readingArray[i] = 0;
  }
  readingArray[20] = millis();
}


/*findHeartRate(): calculates the heart rate.
Modified from code by FrankieChu. */
void findHeartRate()
{
  if (pulseDetected)
  {
    heartRate = 1200000 / (readingArray[20] - readingArray[0]); //60*20*1000/20_total_time
    Serial.print("Heart rate is:\t");
    Serial.println(heartRate);
    playSound();     //call sound method, which will cue a sound based on the heart rate
  }
  pulseDetected = 1; //indicate that pulse was detected, then return to interrupt routine
}


/*playSound(): plays one of four different sounds depending on heart rate input value.
Modified from code by High-Low Tech.*/
void playSound(){
  if (heartRate < 70){
    startPlayback(mrrp, sizeof(mrrp));          //low heart rate, relaxing consistent sound
  }
  else if (heartRate >= 70 && heartRate < 80){  //moderate heart rate, something a bit more sudden
    startPlayback(owlHoot, sizeof(owlHoot));
  }
  else if (heartRate >= 80 && heartRate < 90){
    startPlayback(guitarJingle, sizeof(guitarJingle));  //high heart rate, something instantaneously calming
  } 
  else {
    startPlayback(rowletCry, sizeof(rowletCry));    //very high heart rate, pulling out big guns
  }
}

/*interrupt(): Interrupt service routine. Gets the signal from the external interrupt.
Modified from code by FrankieChu.*/
void interrupt()
{
  readingArray[counter] = millis();
  switch (counter)
  {
    case 0:
      inactivity = readingArray[counter] - readingArray[20];
      break;
    default:
      inactivity = readingArray[counter] - readingArray[counter - 1];
      break;
  }
  if (inactivity > bpmMaxDelayTimer) //if no activity is detected for longer than 2 seconds...
  {
    pulseDetected = 0; //no pulse detected
    counter = 0;       //restart counter
    Serial.println("Heart rate measure error, test will restart!" );
    arrayInit();       //reinitialize array
  }
  if (counter == 20 && pulseDetected)
  {
    counter = 0;       //restart counter
    findHeartRate();   //calculate heart rate
  }
  else if (counter != 20 && pulseDetected)
    counter++;         //keep counting up until counter hits 20
  else                 //if counter is not at 20 but no error was found...
  {
    counter = 0;       //restart counter
    pulseDetected = 1; //
  }

}
